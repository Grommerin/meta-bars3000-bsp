## conf/layer.conf
```bitbake
# We have a conf and classes directory, add to BBPATH
BBPATH .= ":${LAYERDIR}"

# We have a recipes-* directories, add to BBFILES
BBFILES += "${LAYERDIR}/recipes-*/*/*.bb \
	        ${LAYERDIR}/recipes-*/*/*.bbappend"

BBFILE_COLLECTIONS += "meta-bars3000-bsp"
BBFILE_PATTERN_meta-bars3000-bsp = "^${LAYERDIR}/"
BBFILE_PRIORITY_meta-bars3000-bsp = "6"

LAYERVERSION_meta-bars3000-bsp = "1"

# Let us add layer-specific bbappends which are only applied when that
# layer is included in our configuration
BBFILES += "${@' '.join('${LAYERDIR}/%s/recipes*/*/*.bbappend' % layer \
               for layer in BBFILE_COLLECTIONS.split())}"
# Add layer-specific bb files too
BBFILES += "${@' '.join('${LAYERDIR}/%s/recipes*/*/*.bb' % layer \
               for layer in BBFILE_COLLECTIONS.split())}"

LICENSE_PATH += "${LAYERDIR}/LICENSE.Strim"
```

## conf/machine/bars3000.conf
```bitbake
#@TYPE: Machine
#@NAME: bars3000
#@SOC: i.MX6Q
#@DESCRIPTION: Machine configuration for bars3000 systems
#@MAINTAINER: Nikita Divakov n.divakov@strim-tech.com

include conf/machine/include/imx-base.inc
include conf/machine/include/tune-cortexa9.inc

SOC_FAMILY = "mx6:mx6q"
KERNEL_DEVICETREE ?= "imx6q-bars3000.dtb"
KERNEL_IMAGETYPE = "uImage"

PREFERRED_PROVIDER_virtual/bootloader = "u-boot-bars3000"
UBOOT_MACHINE ?= "bars3000_config"

PREFERRED_PROVIDER_virtual/kernel ?= "linux-bars3000"
PREFERRED_VERSION_linux-bars3000 ?= "3.10.53"
# PREFERRED_VERSION_linux-bars3000 ?= "3.14.52"

# Use eMMC U-Boot by default
IMAGE_BOOTLOADER ?= ""

SERIAL_CONSOLE = "115200 ttymxc1"

SOC_DEFAULT_IMAGE_FSTYPES += " sdcard.gz"
SOC_DEFAULT_IMAGE_FSTYPES_mxs += " sdcard.gz"
```

## conf/machine/strimboard-bsp.conf
```bitbake
#@TYPE: Machine
#@NAME: strimboard-bsp

#@DESCRIPTION: Machine configuration for strimboard-bsp systems


MACHINE_EXTRA_RRECOMMENDS = " kernel-modules kernel-devicetree"

EXTRA_IMAGEDEPENDS += "u-boot"

include conf/machine/include/tune-cortexa9.inc

IMAGE_FSTYPES += "tar.bz2 jffs2"
EXTRA_IMAGECMD_jffs2 = "-lnp "

SERIAL_CONSOLE = "115200 ttyO0"


PREFERRED_PROVIDER_virtual/kernel ?= "linux-yocto"
PREFERRED_VERSION_linux-yocto ?= "4.1%"

KERNEL_IMAGETYPE = "uImage"
KERNEL_DEVICETREE = "am335x-bone.dtb am335x-boneblack.dtb"
KERNEL_EXTRA_ARGS += "LOADADDR=${UBOOT_ENTRYPOINT}"

SPL_BINARY = "MLO"
UBOOT_SUFFIX = "img"
UBOOT_MACHINE = "strimboard_config"
UBOOT_ENTRYPOINT = "0x10008000"
UBOOT_LOADADDRESS = "0x10008000"

MACHINE_FEATURES = "usbgadget usbhost vfat alsa"

IMAGE_BOOT_FILES ?= "u-boot.${UBOOT_SUFFIX} MLO"
```
